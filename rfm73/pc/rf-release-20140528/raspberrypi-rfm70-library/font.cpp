#include <stdio.h>
#include <stdlib.h>
#include <iconv.h>
#include <string.h>
 
//#define DEBUG
//#define DISP_MODE1
//#define DISP_RAW_DATA
#define DISP_RAW_DATA_ARRAY

unsigned int get_count_8x16();
unsigned char *get_datas();
int cvt_main(char *argv);

static const char ascii_table[];
static const char as[]={
' ','!','"','#','$','%','&','\'','(',')','*','+',',','-','.','/','0','1','2','3','4','5','6','7','8','9',':',';','<','=','>','?','@','A','B','C','D','E','F','G','H','I','J','K','L','M','N','O','P','Q','R','S','T','U','V','W','X','Y','Z','[','\\',']','^','_','`','a','b','c','d','e','f','g','h','i','j','k','l','m','n','o','p','q','r','s','t','u','v','w','x','y','z','{','|','}','~'
};


static unsigned char HZ_16x16[16][2];
static int display(char *incode, int len);

static void cvt_gb2312(char *p)
{
	iconv_t cd;

	char src[4];
	char *p_src;

	char dst[3];
	char *p_dst;

	size_t src_len;
	size_t dst_len;


	char hz_utf8[4];

	memset(src, 0, 4);
	memcpy(src, p, 3);
	memset(dst, 0, 3);

	p_src = src;
	p_dst = dst;
	src_len=3;
	dst_len=2;

        cd = iconv_open("GB2312", "UTF8");
        if(cd == 0)
                return;
        iconv(cd, &p_src, &src_len, &p_dst, &dst_len);

        iconv_close(cd);

	hz_utf8[0]=src[0];
	hz_utf8[1]=src[1];
	hz_utf8[2]=src[2];
	hz_utf8[3]=0;
	printf("/*%s*/\n", hz_utf8);
	display(dst, 2);
}

void disp_mode1(void)
{
	unsigned char i,j,k;
        for(i = 0; i < 16; i++)
        {
                for(j = 0; j < 2; j++)
                        for(k = 0; k < 8; k++)
                        {
                                if(HZ_16x16[i][j] & (0x80>>k))
                                        printf("#");
                                else
                                        printf("-");
                        }
                printf("\n");
        }
}

void disp_raw_data_array(void)
{
	unsigned char i;
	for(i=0;i<16;i++) {
		printf("0x%02x,", HZ_16x16[i][0]);
		data_package[pkg_index++] = HZ_16x16[i][0];
	}
	printf("\n");
	for(i=0;i<16;i++) {
		printf("0x%02x,", HZ_16x16[i][1]);
		data_package[pkg_index++] = HZ_16x16[i][1];
	}
	printf("\n");
}

int display(char *incode, int len)
{
        int i, j, k;
        FILE    *HZK=NULL;
        unsigned    char    qh,wh;
        unsigned    long    offset;
 
        qh=incode[0]-0xa0;
        wh=incode[1]-0xa0;
        offset=(94*(qh-1)+(wh-1))*32;
#ifdef DEBUG
        printf("区码：%d,位码：%d\n",qh,wh);
#endif
 
        if((HZK=fopen("HZK16","rb")) ==NULL)
        {
           perror("Can't Open hzk16");
           return (EXIT_FAILURE);
        }
        fseek(HZK,offset,SEEK_SET);
        fread(HZ_16x16,32,1,HZK);
        fclose(HZK);
#ifdef DISP_MODE1
	printf("/*\n");
	disp_mode1();
	printf("*/\n");
#endif

#ifdef DISP_RAW_DATA_ARRAY
	disp_raw_data_array();
#endif
        return EXIT_SUCCESS;
}

void print_head(void)
{
#ifdef DISP_RAW_DATA_ARRAY
	printf("#ifndef __HZ_IN_FLASH__\n");
	printf("#define __HZ_IN_FLASH__\n");
        printf("const unsigned char PROGMEM hz_flash[] = {\n");
#endif
}

void print_tail(void)
{
#ifdef DISP_RAW_DATA_ARRAY
	printf("};\n");

	printf("#endif\n");
#endif
}
static unsigned char data_package[1024];
static unsigned int pkg_index=0;

static unsigned int how_many_8x16=0;

unsigned int get_count_8x16()
{
	return how_many_8x16;
}

unsigned char *get_datas()
{
	return data_package;
}


int cvt_main(char *argv)
{
        char *string = argv;
        char *pin1 = string;
        int i,j,k;
	how_many_8x16=0;
	memset(data_package, 0x00, 1024);

	print_head();
	for (i = 0; i < strlen(pin1);) {
		if (0 == (pin1[i] & 0x80)) {
			how_many_8x16++;
			for(j=0;j<sizeof(as);j++) {
				if(as[j]==pin1[i]) {
					printf("/*%c*/\n",as[j]);
					for(k=0;k<16;k++) {
						printf("0x%02x,",(unsigned char)ascii_table[j*16+k]);
						data_package[pkg_index++] = (unsigned char)ascii_table[j*16+k];
					}
					printf("\n");
				}
			}
			i++;
		}else {
			how_many_8x16+=2;
			cvt_gb2312(&pin1[i]);
			i+=3;
		}
	}

	print_tail();
#ifdef DISP_RAW_DATA_ARRAY
	printf("#define HZ_IN_FLASH_LEN  %d\n", how_many_8x16);
#endif
        return 0;
}

const char ascii_table[] = {
0x00,0x00,0x00,0x00,0x00,0x00,0x00,0x00,0x00,0x00,0x00,0x00,0x00,0x00,0x00,0x00,
0x00,0x00,0x00,0x10,0x10,0x10,0x10,0x10,0x10,0x10,0x00,0x00,0x18,0x18,0x00,0x00,
0x00,0x12,0x36,0x24,0x48,0x00,0x00,0x00,0x00,0x00,0x00,0x00,0x00,0x00,0x00,0x00,
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0x30,0x4C,0x43,0x00,0x00,0x00,0x00,0x00,0x00,0x00,0x00,0x00,0x00,0x00,0x00,0x00,
};
